## target/linux/brcm63x8/files-2.6.30/drivers/mtd/brcmnand/.svn/text-base/Kconfig.svn-base
```kconfig
#
# linux/drivers/mtd/brcmnand/Kconfig
#

#menu "Broadcom NAND Flash Device Drivers"
#	depends on MTD != n

config MTD_BRCMNAND
	tristate "Broadcom NAND Device Support"
	default n
	depends on MTD
	help
	  This enables support for accessing selected types of NAND flash
	  devices through the Broadcom NAND controller.

config MTD_BRCMNAND_VERIFY_WRITE
	bool "Verify Broadcom NAND page writes"
	default n
	depends on MTD_BRCMNAND
	help
	  This adds an extra check when data is written to the flash. The
	  Broadcom NAND flash device internally checks only bits transitioning
	  from 1 to 0. There is a rare possibility that even though the
	  device thinks the write was successful, a bit could have been
	  flipped accidentaly due to device wear or something else.

# endmenu

config MTD_BRCMNAND_VERSION
	int "Broadcom Controller version number: 0 = v0.0, 1 = v0.1, 2 = v1.0"
	default 1
	depends on MTD_BRCMNAND
	help
		Version number of the controller.
		Value	Maj.Min Platform
			0		0.0			7400A0
		1	0.1	7401Cx, 7400B0, 7118A0, 7403 * 7451, 7452, 3563
		2	1.0	7440B0, 7405a0 (also 7118C0 running as 1.0 in 2.6.12)
		3	2.0	7325
		4	2.1	7335
		5	2.2	7118C0 & 7405b0 (in 2.6.18) /* Not implemented for 2.6.12 */ 
		6	3.0	3548a0 & 7443a0 (in 2.6.18)
		7	3.1.0	RDB reads as 3.0: 3548b0,3548b1,7420a0: PR2516 fix (OOB Read) 
		8	3.1.1	RDB reads as 3.0: 3548b2,7336a0,7443b0: PR2371 fix (Hamming)
		9	3.2	Device ID decode update, 7413b0
		10	3.3	Expand ACC/CONFIG to allow per chip registers, 7420b0, 7635a0

config MTD_BRCMNAND_CORRECTABLE_ERR_HANDLING
	bool "Refresh a block on a one bit correctable ECC error"
	default y
	depends on MTD_BRCMNAND
	help
	  If there is a 1-bit correctable error detected during NAND flash read, the
	  Broadcom NAND flash driver can refresh the corresponding NAND flash block.
	  Refreshing implies a sequence of read->erase->write. Refreshing the block
	  drastically reduces the probability of occurance of a similar (correctable)
	  error.
	  
config MTD_BRCMNAND_EDU
	bool "Enable Broadcom NAND EDU"
	default n
	depends on MTD_BRCMNAND && (MIPS_BCM7440B0 || MIPS_BCM3548B0)
	help
	   Enable DMA capability of the NAND controller.  
	   Currently only present on the following chips:
	   7440bx, 7440cx, 3548b0, 7443a0
```
